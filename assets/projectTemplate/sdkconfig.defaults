## assets/projectTemplate/sdkconfig.defaults
```kconfig
## Ticks frequency
CONFIG_FREERTOS_HZ=1000

## Debug logging level
CONFIG_LOG_DEFAULT_LEVEL_NONE=y
CONFIG_LOG_DEFAULT_LEVEL_ERROR=y
CONFIG_LOG_DEFAULT_LEVEL_WARN=y
CONFIG_LOG_DEFAULT_LEVEL_INFO=y
CONFIG_LOG_DEFAULT_LEVEL_DEBUG=y
CONFIG_LOG_DEFAULT_LEVEL_VERBOSE=

## C++ exceptions enabled 
CONFIG_CXX_EXCEPTIONS=y
## Emergency pool size for exception objects
CONFIG_CXX_EXCEPTIONS_EMG_POOL_SIZE=2048
```
